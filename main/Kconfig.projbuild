## main/Kconfig.projbuild
```kconfig
menu "AsicOS Configuration"

    choice ASICOS_BOARD
        prompt "Board variant"
        default ASICOS_BOARD_V1
        help
            Select the hardware board variant.

        config ASICOS_BOARD_V1
            bool "AsicOS V1"

        config ASICOS_BOARD_NERDQAXEPP
            bool "NerdQAxe++"

        config ASICOS_BOARD_BITFORGE_NANO
            bool "BitForge Nano"
    endchoice

endmenu
```

## sdkconfig.defaults
```kconfig
# Target
CONFIG_IDF_TARGET="esp32s3"

# CPU
CONFIG_ESP_DEFAULT_CPU_FREQ_MHZ_240=y

# PSRAM
CONFIG_SPIRAM=y
CONFIG_SPIRAM_MODE_OCT=y
CONFIG_SPIRAM_SPEED_40M=y
CONFIG_SPIRAM_TRY_ALLOCATE_WIFI_LWIP=y

# Partition
CONFIG_PARTITION_TABLE_CUSTOM=y
CONFIG_PARTITION_TABLE_CUSTOM_FILENAME="partitions.csv"
CONFIG_ESPTOOLPY_FLASHSIZE_16MB=y

# LWIP
CONFIG_LWIP_MAX_SOCKETS=16

# TLS
CONFIG_MBEDTLS_TLS_ENABLED=y
CONFIG_MBEDTLS_SSL_PROTO_TLS1_2=y
CONFIG_MBEDTLS_SSL_PROTO_TLS1_3=y
CONFIG_MBEDTLS_CERTIFICATE_BUNDLE=y
CONFIG_MBEDTLS_CERTIFICATE_BUNDLE_DEFAULT_FULL=y

# Bluetooth off
CONFIG_BT_ENABLED=n

# Watchdog
CONFIG_ESP_TASK_WDT_INIT=n

# SPIFFS
CONFIG_SPIFFS_MAX_PARTITIONS=3

# HTTP Server
CONFIG_HTTPD_WS_SUPPORT=y
CONFIG_HTTPD_MAX_REQ_HDR_LEN=2048
CONFIG_HTTPD_MAX_URI_LEN=512

# Stack
CONFIG_ESP_MAIN_TASK_STACK_SIZE=8192
```
